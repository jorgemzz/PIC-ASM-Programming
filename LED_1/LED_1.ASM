
	
	LIST	P=16F84A
	INCLUDE	"P16F84A.INC"

;---------MAPA DE MEMORIA-------

	CBLOCK	0X0C

	REG1			;UTILIZANDO LA DIRECTIVA CBLOCK ASIGNO 
	REG2			;LOS NOMBRES A LAS POSICIONES DE MEMORIA
	REG3			;DE DATOOS PARA REALIZAR LOS RETARDOS
	REG4

	ENDC

;-------CONFIGURACION DE PUERTOS---

RESET	ORG	0X00			;INDICA DONDE SE ESCRIBE LA SIGUIENTE INSTRUCCION
		GOTO	INICIO		;SALTA A INICIO
		ORG	0X05
INICIO	BSF		STATUS,RP0	;SALTO AL BANCO 1
		MOVLW	B'00000000'		;CARGA W CON 00000000
		MOVWF	TRISB		;CONFIGURA LOS PINES DE PORT B COMO SALIDA
		BCF		STATUS,RP0	;REGRESA AL BANCO 0
		CLRF PORTB

;-------AQUI ENCIENDE Y APAGA EL LED-----

AHORA	BSF		PORTB,0		;PONE UN UNO EN RB0
		CALL 	RETARDO 	;LLAMA AL RETARDO

		BCF		PORTB,0		;AL REGRESAR DE RETARDO PONGO 0 A RB0
		CALL	RETARDO		;LLAMA A RETARDO
		GOTO	AHORA		;LUEGO REPITE TODO DE NUEVO

;-----RUTINA DE RETARDO----------

RETARDO	MOVLW	10			;CARGO CON 10 EN HEADEC A REG 1
		MOVWF	REG1

TRES	MOVLW	10
		MOVWF	REG2

DOS		MOVLW	15
		MOVWF	REG3

UNO		MOVLW	20
		MOVWF	REG4

CERO	DECFSZ	REG4,1		;COMIENZA A DECREMENTAR REG4 SI LLEGAA 0 SE SALTA UNA INSTRUCCION
		GOTO    CERO		;PARA DECREMENTAR REG4 HASTA CERO
		DECFSZ	REG3,1		;Cuando reg4 llegue a 0 decrementaré reg3 en una unidad
		GOTO 	UNO			;volveré a cargar reg4y lo decrementaré nuevamente
		DECFSZ	REG2,1		; para recién restarle otra unidad a reg3
		GOTO	DOS			;así... hasta que reg2 se haga cero.
		DECFSZ	REG1,1		;todo esto ocurrirá hasta que reg1 se haga igual a cero.
		GOTO	TRES
		RETLW	0X0			;REGRESO A DONDE  SE HIZO LA LLAMADA CARGANDE W CON 0

;--------------------

	END 		;FIN

		
		
	
