
;modificandoi el original para  usar solo 2 display .....se acabaron los fondos


;---------------------ENCABEZADO--------------

	LIST		P=16F84A
	INCLUDE		"P16F84A.INC"

;------------VARIABLES A UTILIZAR-----------

	CBLOCK		0X0D
		PDel0
		PDel1
		RET1
		RET2			;REGIDTROS PARA RETARDOS
		TIEMPO_1			;ESTOS SON MIOS
		TIEMPO_2
		TIEMPO_3
		INDICA
		ROTA			;REGISTRO PARA ROTACION(CAMBIO DE DISPLAY)
		DISP1			;PRIMER DATO A MOSTRAR
		DISP2			;SEGUNDO DATO A MOSTRAR
		DISP3			;TERCER	DATO A MOSTRAR
		DISP4			;CUARTO DATO A MOSTRAR

	ENDC

;---------CONFIGURACION DE PUERTOS---------

RESET	ORG		0X00
		GOTO	INICIO
		ORG		0X05

INICIO	BSF		STATUS,RP0		;CONFIGURANDO PUERTOS
		CLRF	TRISA			;PORTA ES SALIDA
		CLRF	TRISB			;PORTB ES SALIDA
		BCF		STATUS,RP0

;--------CARGA DE REGISTROS A MOSTRAR-------

		MOVLW	0X01
		MOVWF	DISP1
		MOVLW	0X02
		MOVWF	DISP2
		MOVLW	0X03
		MOVWF	DISP3
		MOVLW	0X04
		MOVWF	DISP4

;--------------APAGA TRANSISTORES------------
		
		CLRF	PORTA

;--------------PARA EL OTRO_RETARDO-----------

		CLRF	TIEMPO_1		;PA MI RETARDO
		CLRF	TIEMPO_2		;PA MI RETARDO
		CLRF	INDICA
		MOVLW	.254
		MOVWF	TIEMPO_2
		MOVLW	.190
		MOVWF	TIEMPO_1

;-------------PROGRAMA PRINCIPAL-------------

INI
CONT_1	INCFSZ	TIEMPO_1,F
		GOTO	SEGUIR
CONT_2	INCFSZ	TIEMPO_2,F
		GOTO	SEGUIR
		BSF		INDICA,0			;PONE EL INDICADOR A UNO

		MOVLW	0X08
		MOVWF	ROTA		;ROTA=00001000

		MOVLW	DISP1
		MOVWF	FSR			;CARGA FSR CON LA DIRECCION DE DISP1

DISPLAY	MOVLW	0X00		;APAGO TODOS LOS DISPLAY
		MOVWF	PORTB		;PORTB=00000000

		MOVF	ROTA,W		;SELECCIONAMOS EL TRANSISTOR DEL DISPLAY DE  LA IZQUIERDA
		MOVWF	PORTA		;PORTA=00001000	

		MOVF	INDF,W		;LEE DATO AL QUE APUNTA FSR OSEA DISP1
		CALL	TABLA		;LLAMA A TABLA
		MOVWF	PORTB		;PASA EL DATO OBTENIDO A PORTB

		CALL	RETARDO		;LLA,A AL MINIRETARDO
		BTFSC	ROTA,0		;ROTA="00000001"...???	
		GOTO	INI			;SI ES SI SE VIO TODO, REINICIA	
		
		BCF		STATUS,C	;CARRY=0, PARA NO AFECTAR ROTACIONES
		BTFSC	INDICA,0
		GOTO    SOLO_UNO
		RRF		ROTA,F		;ROTA DISPLAY
		INCF	FSR,F		;APUNTA AL SIGUIENTE DISP_X
		GOTO	DISPLAY

;----------------------RETARDO-------------------

RETARDO	MOVLW	0X03
		MOVWF	RET1
DOS		MOVLW	0X6E
		MOVWF	RET2
UNO		NOP
		NOP
		NOP
		NOP
		NOP
		NOP
		DECFSZ	RET2,F
		GOTO	UNO
		DECFSZ	RET1,F
		GOTO	DOS
		RETLW	0X00

;------------------------TABLA-------------------

TABLA	ADDWF	PCL,F		;SE INCREMENTA EL CONTADORE DE PROGRAMA
		;display . gfedcba segmentos de los leds del display
		NOP
		RETLW 	B'00111000' ; código para la L 
		RETLW 	B'00111110' ; código para la U 
		RETLW 	B'00000110' ; código para la I 
		RETLW 	B'11101101' ; código para la S.

;------------------APAGAR------------------

APAGO_TODO	CLRF	PORTA
			GOTO	APAGO_TODO

SOLO_UNO	CLRF	PORTA
SIGUE		BSF		PORTA,3
			GOTO	SIGUE

;-------------------------------------------------
	END
;-------------------------------------------------


