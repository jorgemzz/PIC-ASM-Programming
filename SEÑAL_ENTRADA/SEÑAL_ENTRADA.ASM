
	
	LIST	P=16F84A
	INCLUDE	"P16F84A.INC"

;---------MAPA DE MEMORIA-------

	CBLOCK	0X0C

	CONT

	ENDC

;-------CONFIGURACION DE PUERTOS---

RESET	ORG	0X00			;INDICA DONDE SE ESCRIBE LA SIGUIENTE INSTRUCCION
		GOTO	INICIO		;SALTA A INICIO
		ORG	0X05
INICIO	BSF		STATUS,RP0	;SALTO AL BANCO 1
		MOVLW	0X02		;CARGA W CON 00000010
		MOVWF	TRISA		;AHORA	RA1 ES ENTRADA
		CLRF	TRISB		;Y PORTB ES SALIDA
		BCF		STATUS,RP0	;REGRESA AL BANCO 0

;------------------------------------------------

	CLRF	PORTB			;LIMPIO DEL PUERTO B
	CLRF	CONT			;LIMPIO EL CONTADOR
	BSF		CONT,0			;PONGO EL CONTADOR  A UNO

;.----------------TEST----------------

TEST	BTFSC	PORTA,1		;SI ALGUIEN PRESIONA VOY 
		CALL	LED			;A LA ETIQUETA LED
		GOTO	TEST		;SINO SIGUE ESPERANDO

LED		BTFSC	CONT,0		;SI EL CONTADOR ESTA A UNO 
		GOTO 	ON_LED		;LO ATIENDE EN ON LED
		BCF		PORTB,0		;SINO APAGO EL LED
		BSF		CONT,0		;PONGO EL CONTADOR A 1
		GOTO	LIBRE		;Y ESPERO QUE SUELTEN EL PULSADOR

ON_LED	BSF		PORTB,0		;ENCIENDO EL LED
		CLRF	CONT		;PONGO EL CONTADORE A 0

LIBRE	BTFSC	PORTA,1		;SINO SUELTAN EL PULSADOR ME QUEDARE ESPERANDO
		GOTO 	LIBRE

		RETURN

;---------SE ACABO-----------------

	END

