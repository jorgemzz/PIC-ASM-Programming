;==================== Encabezado ====================

		LIST	P=16F84A
		INCLUDE	"P16F84A.INC"

;================= Mapa de Memoria ===================

	Digito	EQU	0X0C
	DATO_A 	EQU	0X0D
	DATO_B 	EQU	0X0E
	PDel0	EQU	0X0F
	PDel1	EQU	0X10
	PDel2	EQU	0X11		
 	RA	EQU	PORTA
	RB	EQU	PORTB

;<<<<<<----------------- INICIO PROGRAMA PRINCIPAL ------------------->>>>>>>

INICIO      CLRF         Digito             ;Pone a 0 la variable digito 
               CALL         LCD_PORT    ;Puertos en modo LCD 
               BCF           RA,0              ;Desactiva RS del modulo LCD
               BCF           RA,2              ;Desactiva E del modulo LCD 
START    CALL        LCD_INI          ;Inicia LCD (CFG puertos...) 
               MOVLW    b'00000001'   ;Borrar LCD y Home 
               CALL        LCD_REG 
               MOVLW    b'00000110'  
               CALL        LCD_REG 
               MOVLW    b'00001100'   ;LCD On, cursor Off,Parpadeo Off 
               CALL        LCD_REG 
               MOVLW   0x80               ;Direccion caracter
               CALL        LCD_REG 

REPETIR  MOVF      Digito,w          ;W=Digito
               CALL       DATO_1          ;Coge el caracter 
               IORLW     0                      ;Compara 
               BTFSC     STATUS,2       ;Es el ultimo? 
               GOTO      acabar            ;Si 
               CALL       LCD_DATOS   ;Visualiza caracter 
               INCF        Digito,f             ;Incrementa numero de Digito
               GOTO     REPETIR           ;Vuelve a escribir

acabar   nop
	
			   CALL		PDelay
               MOVLW    b'00011000'  
               CALL        LCD_REG 

              goto        acabar              ;Buclee infinito


;<<<<<<---------------------- TABLA DE DATOS ------------------------->>>>>>> 

DATO_1          ADDWF   PCL,1                  
                RETLW   'H'             
                RETLW   'O'
                RETLW   'L'           
                RETLW   'A'           
                RETLW   '_'           
                RETLW   'L'           
                RETLW   'O'           
                RETLW   'B'           
                RETLW   'O'           
                RETLW   '_' 
                RETLW   'F'           
                RETLW   'E'           
                RETLW   'R'           
                RETLW   'O'           
                RETLW   'Z'     
          		RETLW   ':'

                RETLW 	0x00           
 
;-------------------------------------------------------------
; Code generated by PDEL  ver 1.0  on 05/11/2009 at 07:04:14 a.m.
; Description: Waits 1000000 cycles
;-------------------------------------------------------------
PDelay  movlw     .14       ; 1 set number of repetitions (C)
        movwf     PDel0     ; 1 |
PLoop0  movlw     .72       ; 1 set number of repetitions (B)
        movwf     PDel1     ; 1 |
PLoop1  movlw     .247      ; 1 set number of repetitions (A)
        movwf     PDel2     ; 1 |
PLoop2  clrwdt              ; 1 clear watchdog
        decfsz    PDel2, 1  ; 1 + (1) is the time over? (A)
        goto      PLoop2    ; 2 no, loop
        decfsz    PDel1,  1 ; 1 + (1) is the time over? (B)
        goto      PLoop1    ; 2 no, loop
        decfsz    PDel0,  1 ; 1 + (1) is the time over? (C)
        goto      PLoop0    ; 2 no, loop
PDelL1  goto PDelL2         ; 2 cycles delay
PDelL2  clrwdt              ; 1 cycle delay
        return              ; 2+2 Done
;-------------------------------------------------------------

		INCLUDE		"LCD.LIB"

	END


