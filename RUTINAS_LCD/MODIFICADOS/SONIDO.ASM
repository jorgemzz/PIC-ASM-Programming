
	LIST	P=16F84A
	INCLUDE	"P16F84A.INC"

;Declarando variables

	CBLOCK	0X0C
		WCYCLE
		PRESCwait
		Beep_TEMP1
		Beep_TEMP2
		Beep_TEMP3
	ENDC

;Definir el hardware

	#define	BEEPport	PORTA,3
	#define	BEEPtris	TRISA,3

;Estructura de la memoria de programa

	ORG	0X00
	goto	Main
	ORG	0X04
	goto	Main

	INCLUDE	"bank.inc"	
	INCLUDE	"button.inc"
	INCLUDE	"wait.inc"
	INCLUDE	"beep.inc"

Main
	BANK1
	movlw	0x17
	movwf	TRISA
	clrf	TRISB
	BANK0

	BEEPinit
	clrf	PORTB

Loop
	Button	0,PORTA,0,.100,Play1
	Button	0,PORTA,1,.100,Play2
	goto	Loop

Play1
	BEEP	0XFF,0X03
	BEEP	0XDC,0X03
	BEEP	0XEB,0X03
	BEEP	0XDC,0X03
	BEEP	0XDC,0X03
	BEEP	0XEB,0X03
	BEEP	0XDC,0X03
	BEEP	0XFF,0X03
	BEEP	0XDC,0X03
	BEEP	0XEB,0X03
	BEEP	0XDC,0X03
	BEEP	0XDC,0X03
	BEEP	0XEB,0X03
	BEEP	0XDC,0X03

	WAIT	0XFF



	RETURN

Play2
	;BEEP	0XAA,0X02
	;BEEP	0X87,0X05
	;BEEP	0XA2,0X03
	;BEEP	0X98,0X03

	BEEP	0XFF,0X03
	BEEP	0XEE,0X03
	BEEP	0XDD,0X03
	BEEP	0XCC,0X03
	BEEP	0XBB,0X03
	BEEP	0XAA,0X03
	BEEP	0X99,0X03
	BEEP	0X88,0X03
	BEEP	0X77,0X03
	BEEP	0X66,0X03
	BEEP	0X55,0X03
	BEEP	0X44,0X03
	BEEP	0X33,0X03
	BEEP	0X22,0X05

	RETURN

	end